/**
 * @cliArgs --device "MSP432P401R" --package "PZ100" --part "Default"
 * @versions {"data":"2020090214","timestamp":"2020090214","tool":"1.6.0+1543","templates":"2020090214"}
 */

/**
 * These are the peripherals and settings in this configuration
 */
const iGPIO1                = scripting.addPeripheral("GPIO");
iGPIO1.$numPins             = 2;
iGPIO1["0"]["i/o_pu/pd"]    = "GPIO_CFG_OUT_OD_PU";
iGPIO1["0"].output_value    = "GPIO_CFG_OUT_HIGH";
iGPIO1["0"].output_strength = "GPIO_CFG_OUT_STR_HIGH";
iGPIO1["0"].$assign         = "P1.0.GPIO/EUSCI_A0_SPI.STE";
iGPIO1["1"]["i/o_pu/pd"]    = "GPIO_CFG_OUT_OD_PU";
iGPIO1["1"].output_value    = "GPIO_CFG_OUT_HIGH";
iGPIO1["1"].output_strength = "GPIO_CFG_OUT_STR_HIGH";
iGPIO1["1"].$assign         = "P2.2.GPIO/EUSCI_A1_UART.RXD/EUSCI_A1_SPI.SOMI";
iGPIO1.$name                = "MyGPIO1";
const iSYSTEM1              = scripting.addPeripheral("SYSTEM");
iSYSTEM1.$name              = "MySYSTEM1";
iSYSTEM1.SMCLK.$assign      = "P7.0.GPIO/DMA.DMAE0/CS.SMCLK";

/**
 * Pinmux solution for unlocked pins/peripherals. This ensures that minor changes to the automatic solver in a future
 * version of the tool will not impact the pinmux you originally saw.  These lines can be completely deleted in order to
 * re-solve from scratch.
 */
iSYSTEM1.$suggestSolution        = "SYSTEM";
iSYSTEM1.ACLK.$suggestSolution   = "P4.2.GPIO/CS.ACLK/Timer_A2.CLK/ADC14.A11";
iSYSTEM1.MCLK.$suggestSolution   = "P4.3.GPIO/CS.MCLK/RTC_C.CLK/ADC14.A10";
iSYSTEM1.HSMCLK.$suggestSolution = "P4.4.GPIO/CS.HSMCLK/ADC14.A9";
